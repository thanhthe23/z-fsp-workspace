## boards/arduino/uno_r4_wifi/arduino_uno_r4_wifi_custom_defconfig
```kconfig
# Copyright (c) 2025 The.Thanh Nguyen <the.nguyen.yf@outlook.com>
# SPDX-License-Identifier: Apache-2.0

# Enable GPIO
CONFIG_GPIO=y

CONFIG_USE_DT_CODE_PARTITION=y

CONFIG_CONSOLE=y
CONFIG_USE_SEGGER_RTT=y
CONFIG_RTT_CONSOLE=y
```

## boards/arduino/uno_r4_wifi/board.yml
```yaml
board:
  name: arduino_uno_r4_wifi_custom
  vendor: arduino
  socs:
  - name: r7fa4m1ab3cfm_custom
```

## drivers/Kconfig
```kconfig
# Copyright (c) 2025 The.Thanh Nguyen <the.nguyen.yf@outlook.com>
# SPDX-License-Identifier: Apache-2.0

menu "Device Drivers"

rsource "gpio/Kconfig"
rsource "serial/Kconfig"

endmenu
```

## drivers/gpio/Kconfig
```kconfig
# Copyright (c) 2025 The.Thanh Nguyen <the.nguyen.yf@outlook.com>
# SPDX-License-Identifier: Apache-2.0

config GPIO_RENESAS_RA_IOPORT
	bool "Renesas RA GPIO I/O Port driver"
	default y
	depends on DT_HAS_RENESAS_RA_IOPORT_ENABLED
	select RENESAS_RA_FSP_IOPORT
	help
	  Enable the Renesas RA GPIO I/O Port driver.
```

## drivers/serial/Kconfig
```kconfig
# Copyright (c) 2025 The.Thanh Nguyen <the.nguyen.yf@outlook.com>
# SPDX-License-Identifier: Apache-2.0

config UART_RENESAS_RA_SCI
	bool "Renesas RA SCI UART"
	default y
	depends on DT_HAS_ZEPHYR_RENESAS_RA_UART_SCI_ENABLED
	select PINCTRL
	help
	  Enable support for Renesas RA SCI UART driver.

if UART_RENESAS_RA_SCI

config UART_RENESAS_RA_BAUDRATE_ERROR
	int "Renesas RA SCI UART acceptable baudrate error"
	default 15000
	help
	  Set the acceptable baudrate error for Renesas RA SCI UART.
	  The value is in ppm (parts per million). The default value is 15000 ppm,
	  which corresponds to a 1.5% error rate.

endif
```

## dts/bindings/gpio/renesas,ra-ioport.yaml
```yaml
# Copyright (c) 2025 The.Thanh Nguyen <the.nguyen.yf@outlook.com>
# SPDX-License-Identifier: Apache-2.0

description: Renesas RA I/O Port Controller

compatible: "renesas,ra-ioport"

include: [gpio-controller.yaml, base.yaml]

gpio-cells:
  - pin
  - flags
```

## dts/bindings/serial/renesas,ra-uart-sci.yaml
```yaml
# Copyright (c) 2025 The.Thanh Nguyen <the.nguyen.yf@outlook.com>
# SPDX-License-Identifier: Apache-2.0

description: Renesas RA SCI UART Controller

compatible: "renesas,ra-uart-sci"

include: [uart-controller.yaml, base.yaml]
```

## modules/hal_fsp/Kconfig
```kconfig
# Copyright (c) 2025 The.Thanh Nguyen <the.nguyen.yf@outlook.com>
# SPDX-License-Identifier: Apache-2.0

config ZEPHYR_HAL_FSP_MODULE
	bool

rsource "ra/Kconfig.renesas_ra"
```

## modules/hal_fsp/ra/Kconfig.renesas_ra
```kconfig
# Copyright (c) 2025 The.Thanh Nguyen <the.nguyen.yf@outlook.com>
# SPDX-License-Identifier: Apache-2.0

config HAS_RENESAS_RA_FSP
	bool
	depends on SOC_FAMILY_RENESAS_RA

if HAS_RENESAS_RA_FSP

config RENESAS_RA_FSP_IOPORT
	bool
	help
	  Include RA FSP IOPORT driver.

config RENESAS_RA_FSP_SCI_UART
	bool
	help
	  Include RA FSP SCI UART driver.

endif # HAS_RENESAS_RA_FSP
```

## soc/renesas/ra/Kconfig
```kconfig
# Copyright (c) 2025 The.Thanh Nguyen <the.nguyen.yf@outlook.com>
# SPDX-License-Identifier: Apache-2.0

config SOC_FAMILY_RENESAS_RA_CUSTOM
	bool
	select HAS_SEGGER_RTT

config SOC_FAMILY
	default "renesas_ra_custom" if SOC_FAMILY_RENESAS_RA_CUSTOM

rsource "*/Kconfig"
```

## soc/renesas/ra/ra4m1_custom/Kconfig
```kconfig
# Copyright (c) 2025 The.Thanh Nguyen <the.nguyen.yf@outlook.com>
# SPDX-License-Identifier: Apache-2.0

config SOC_SERIES_RA4M1_CUSTOM
	select ARM
	select CPU_CORTEX_M4
	select CPU_HAS_ARM_MPU
	select HAS_RENESAS_RA_FSP
	select CPU_CORTEX_M_HAS_DWT
	select CPU_HAS_FPU
	select FPU
	select HAS_SWO
	select XIP
	select SOC_EARLY_INIT_HOOK
```

## soc/renesas/ra/ra4m1_custom/Kconfig.defconfig
```kconfig
# Copyright (c) 2025 The.Thanh Nguyen <the.nguyen.yf@outlook.com>
# SPDX-License-Identifier: Apache-2.0

if SOC_SERIES_RA4M1_CUSTOM

config NUM_IRQS
	default 32

config SYS_CLOCK_HW_CYCLES_PER_SEC
	default 48000000

config BUILD_OUTPUT_HEX
	default y

endif # SOC_SERIES_RA4M1_CUSTOM
```

## soc/renesas/ra/ra4m1_custom/Kconfig.soc
```kconfig
# Copyright (c) 2025 The.Thanh Nguyen <the.nguyen.yf@outlook.com>
# SPDX-License-Identifier: Apache-2.0

config SOC_SERIES_RA4M1_CUSTOM
	bool
	select SOC_FAMILY_RENESAS_RA_CUSTOM
	help
	  Renesas RA4M1 series

config SOC_R7FA4M1AB3CFM_CUSTOM
	bool
	select SOC_SERIES_RA4M1_CUSTOM
	help
	  R7FA4M1AB3CFM

config SOC_SERIES
	default "ra4m1_custom" if SOC_SERIES_RA4M1_CUSTOM

config SOC
	default "r7fa4m1ab3cfm_custom" if SOC_R7FA4M1AB3CFM_CUSTOM
```

## west.yml
```yaml
# Copyright (c) 2025 The.Thanh Nguyen <the.nguyen.yf@outlook.com>
# SPDX-License-Identifier: Apache-2.0

manifest:
  remotes:
    - name: zephyrproject-rtos
      url-base: https://github.com/zephyrproject-rtos
    - name: thenguyenyf
      url-base: https://github.com/thanhthe23

  projects:
    - name: zephyr
      remote: zephyrproject-rtos
      revision: main
      import:
        name-allowlist:
          - TraceRecorderSource
          - canopennode
          - chre
          - cmsis
          - cmsis-dsp
          - cmsis-nn
          - edtt
          - fatfs
          - liblc3
          - libmetal
          - littlefs
          - loramac-node
          - lvgl
          - lz4
          - mcuboot
          - mipi-sys-t
          - net-tools
          - open-amp
          - picolibc
          - segger
          - uoscore-uedhoc
          - zcbor
          - zscilib
          - openthread
    - name: hal_fsp
      remote: thenguyenyf
      repo-path: z-fsp
      revision: master
      path: modules/hal/hal_fsp
      submodules: true

self:
  path: fsp
```
